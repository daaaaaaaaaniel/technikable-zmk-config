## west.yml
```yaml
manifest:
  remotes:
    - name: zmkfirmware
      url-base: https://github.com/zmkfirmware
    - name: urob
      url-base: https://github.com/urob/
  projects:
    - name: zmk
      remote: urob
      revision: fix-mod-morph
      import: app/west.yml
  self:
    path: config
```
